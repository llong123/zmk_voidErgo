## boards/shields/voidergo/Kconfig.defconfig
```kconfig
if SHIELD_VOIDERGO_LEFT

config ZMK_KEYBOARD_NAME
    default "VoidErgo"

config ZMK_SPLIT_ROLE_CENTRAL
    default y

endif

if SHIELD_VOIDERGO_LEFT || SHIELD_VOIDERGO_RIGHT

config ZMK_SPLIT
    default y

endif
```

## config/boards/shields/voidergo/Kconfig.shield
```kconfig
# Copyright (c) 2020 Pete Johanson
# SPDX-License-Identifier: MIT
config ZMK_SPLIT_ROLE_CENTRAL
    bool "Enable split keyboard central role"
    default y

config SHIELD_VOIDERGO_LEFT
    def_bool $(shields_list_contains,voidergo_left)

config SHIELD_VOIDERGO_RIGHT
    def_bool $(shields_list_contains,voidergo_right)
```
